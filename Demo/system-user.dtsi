/include/ "system-conf.dtsi"
#include <dt-bindings/gpio/gpio.h>

/ {
};

&ov5640_dma_top_0 {
	sccb-adapter = <&i2c0>;		/* 标准 PS I2C 控制器 (经 EMIO), 或 &axi_iic */
	sccb-addr = <0x3c>;		/* 7bit 地址, 对应 SCCB ID 0x78 */

	width  = <1280>;		/* 输出分辨率 */
	height = <720>;
	total-hsize = <2570>;		/* 行总像素 (帧率) */
	total-vsize = <980>;		/* 场总行数 (帧率) */
	buffer-num = <3>;		/* DDR 缓存块数 1~3 */
};

&vcu_0{
	reset-gpios = <&gpio 78 GPIO_ACTIVE_HIGH>;
};

